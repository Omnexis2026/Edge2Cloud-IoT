## firmware/esp32/Kconfig.projbuild
```kconfig
menu "Home automation device"
    config HA_WIFI_SSID
        string "WiFi SSID"
        default ""
        help
            Your 2.4 GHz Wi‑Fi network name. Set via menuconfig or sdkconfig.defaults.

    config HA_WIFI_PASSWORD
        string "WiFi password"
        default ""
        help
            Leave empty for open networks (not recommended).

    config HA_MQTT_BROKER_URI
        string "MQTT broker URI"
        default "mqtt://192.168.1.10:1883"
        help
            LAN IP of the machine running Docker Mosquitto, e.g. mqtt://192.168.1.10:1883

    config HA_MQTT_USERNAME
        string "MQTT username (must match broker passwd file)"
        default "home"

    config HA_MQTT_PASSWORD
        string "MQTT password"
        default "home-dev-change-me"
        help
            Match services/broker/passwd or regenerate with mosquitto_passwd. Change for production.

    config HA_HOME_ID
        string "Home ID (topic prefix)"
        default "demo"
        help
            Used in topic path home/{HA_HOME_ID}/device/{deviceId}/…
endmenu
```

## firmware/esp32/main/Kconfig.projbuild
```kconfig
menu "Home automation device"
    config HA_WIFI_SSID
        string "WiFi SSID"
        default ""
        help
            Your 2.4 GHz Wi‑Fi network name. Set via menuconfig or sdkconfig.defaults.

    config HA_WIFI_PASSWORD
        string "WiFi password"
        default ""
        help
            Leave empty for open networks (not recommended).

    config HA_MQTT_BROKER_URI
        string "MQTT broker URI"
        default "mqtt://192.168.1.10:1883"
        help
            LAN IP of the machine running Docker Mosquitto, e.g. mqtt://192.168.1.10:1883

    config HA_MQTT_USERNAME
        string "MQTT username (must match broker passwd file)"
        default "home"

    config HA_MQTT_PASSWORD
        string "MQTT password"
        default "home-dev-change-me"
        help
            Match services/broker/passwd or regenerate with mosquitto_passwd. Change for production.

    config HA_HOME_ID
        string "Home ID (topic prefix)"
        default "demo"
        help
            Used in topic path home/{HA_HOME_ID}/device/{deviceId}/…

    config HA_BURGLAR_ENABLE
        bool "Enable wired burglar (intrusion) zone inputs"
        default n
        help
            NC loops to GND with internal pull-up: closed = secure (LOW), open = alarm (HIGH).
            Publishes JSON on the telemetry topic when zone state changes (debounced).

    config HA_ZONE0_GPIO
        depends on HA_BURGLAR_ENABLE
        int "GPIO for zone 0 (-1 = unused)"
        range -1 39
        default -1

    config HA_ZONE1_GPIO
        depends on HA_BURGLAR_ENABLE
        int "GPIO for zone 1 (-1 = unused)"
        range -1 39
        default -1

    config HA_ZONE2_GPIO
        depends on HA_BURGLAR_ENABLE
        int "GPIO for zone 2 (-1 = unused)"
        range -1 39
        default -1

    config HA_ZONE3_GPIO
        depends on HA_BURGLAR_ENABLE
        int "GPIO for zone 3 (-1 = unused)"
        range -1 39
        default -1
endmenu
```

## firmware/esp32/sdkconfig.defaults
```kconfig
# Defaults — override locally (sdkconfig) or menuconfig; do not commit secrets.
CONFIG_ESP_CONSOLE_UART_DEFAULT=y
```
